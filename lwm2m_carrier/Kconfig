## lwm2m_carrier/Kconfig
```kconfig
#
# Copyright (c) 2019 Nordic Semiconductor
#
# SPDX-License-Identifier: LicenseRef-BSD-5-Clause-Nordic
#

config NRFXLIB_LWM2M_CARRIER
	bool "nRF LWM2M Carrier library."
```
